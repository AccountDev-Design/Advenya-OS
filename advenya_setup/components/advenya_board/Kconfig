## advenya_setup/components/advenya_board/Kconfig
```kconfig
menu "ADVENYA · Placa GUITION JC4880P443C_I_W"

    config ADV_BOARD_BACKLIGHT_DEFAULT
        int "Brillo inicial de la retroiluminacion (%)"
        range 5 100
        default 80
        help
            Mismo valor por defecto que Flex OS Ultra (gBright = 80).

    config ADV_BOARD_TOUCH_SWAP_XY
        bool "GT911: intercambiar ejes X/Y"
        default n
        help
            Equivalente a GT911_SWAP_XY de Flex OS Ultra (0 en la placa de referencia).

    config ADV_BOARD_TOUCH_FLIP_X
        bool "GT911: espejo en X"
        default n

    config ADV_BOARD_TOUCH_FLIP_Y
        bool "GT911: espejo en Y"
        default n

endmenu
```

## advenya_setup/components/advenya_lvgl_port/Kconfig
```kconfig
menu "ADVENYA · Port de LVGL"

    config ADV_LVGL_TASK_CORE
        int "Nucleo de la tarea de LVGL"
        range 0 1
        default 1

    config ADV_LVGL_TASK_PRIORITY
        int "Prioridad de la tarea de LVGL"
        default 4

    config ADV_LVGL_TASK_STACK
        int "Pila de la tarea de LVGL (bytes)"
        default 12288

    config ADV_LVGL_BUF_LINES
        int "Lineas de cada buffer de dibujo (2 buffers en RAM interna)"
        range 20 200
        default 80
        help
            480 x 80 x 2 B = 75 KB por buffer. Con PSRAM disponible y poca RAM
            interna se puede bajar; mas lineas = menos llamadas de flush.

    config ADV_LVGL_FLUSH_TIMEOUT_MS
        int "Espera maxima del fin de copia DMA2D (ms)"
        default 120
        help
            Igual que Flex OS Ultra: 120 ms (mas de siete periodos a 60 Hz).

    config ADV_DIAG_ENABLE
        bool "Diagnostico periodico (FPS, tiempos de render, memoria)"
        default y

    config ADV_DIAG_PERIOD_MS
        int "Periodo del informe de diagnostico (ms)"
        depends on ADV_DIAG_ENABLE
        default 5000

endmenu
```

## advenya_setup/main/Kconfig.projbuild
```kconfig
menu "ADVENYA · Asistente de configuracion"

    config ADV_SETUP_RESET_ON_BOOT
        bool "Borrar el estado del asistente en cada arranque (desarrollo)"
        default n
        help
            Borra el blob de NVS antes de cargarlo: el asistente empieza
            siempre desde la bienvenida. Solo para pruebas.

endmenu
```
